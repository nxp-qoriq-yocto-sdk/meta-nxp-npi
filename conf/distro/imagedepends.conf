## conf/distro/imagedepends.conf
```bitbake
# pkgs to be installed for specific board
EXTRA_IMAGEDEPENDS_append_t2080rdb = " cs4315-firmware"
EXTRA_IMAGEDEPENDS_append_t2080rdb-64b = " cs4315-firmware"
EXTRA_IMAGEDEPENDS_append_t4240rdb = " cs4315-firmware"
EXTRA_IMAGEDEPENDS_append_t4240rdb-64b = " cs4315-firmware"
```

## conf/layer.conf
```bitbake
# We have a conf and classes directory, add to BBPATH
BBPATH .= ":${LAYERDIR}"

# We have a packages directory, add to BBFILES
BBFILES += "${LAYERDIR}/recipes-*/*/*.bb \
            ${LAYERDIR}/recipes-*/*/*.bbappend"

BBFILE_COLLECTIONS += "nxp-npi"
BBFILE_PATTERN_nxp-npi := "^${LAYERDIR}/"
BBFILE_PRIORITY_nxp-npi = "5"

PREFERRED_VERSION_qemu = "2.6.2+fsl"

# The dynamic-layers directory hosts the extensions and layer specific
# modifications related to NXP products.
#
# The .bbappend and .bb files are included if the respective layer
# collection is available.
BBFILES += "${@' '.join('${LAYERDIR}/dynamic-layers/%s/recipes*/*/*.bbappend' % layer \
               for layer in BBFILE_COLLECTIONS.split())}"
BBFILES += "${@' '.join('${LAYERDIR}/dynamic-layers/%s/recipes*/*/*.bb' % layer \
               for layer in BBFILE_COLLECTIONS.split())}"
```

## conf/machine/ls1012afrdm.conf
```bitbake
#@TYPE: Machine
#@NAME: Freescale LS1012AFRDM
#@SOC: LSCH2
#@DESCRIPTION: Machine configuration for running LS1012A in 64-bit mode
#@MAINTAINER: Zongchun Yu <Zongchun.Yu@nxp.com>

require conf/machine/include/qoriq-arm64.inc

SOC_FAMILY = "fsl-lsch2:ls1012a"

UBOOT_CONFIG ??= "qspi"
UBOOT_CONFIG[qspi] = "ls1012afrdm_qspi_config,,u-boot-dtb.bin"

KERNEL_DEVICETREE ?= "freescale/fsl-ls1012a-frdm.dtb"
KERNEL_DEFCONFIG ?= "${S}/arch/arm64/configs/defconfig"

SERIAL_CONSOLES ?= "115200;ttyS0 115200;ttyAMA0"
SERIAL_CONSOLES_CHECK ?= "${SERIAL_CONSOLES}"

EXTRA_IMAGEDEPENDS += "ppa ls1012a-rcw"
USE_VT = "0"
```

## conf/machine/ls1012ardb-32b.conf
```bitbake
#@TYPE: Machine
#@NAME: Freescale LS1012ARDB-32B
#@SOC: LSCH2
#@DESCRIPTION: Machine configuration for running LS1012A in 32-bit mode
#@MAINTAINER: Zongchun Yu <Zongchun.Yu@nxp.com>

require conf/machine/include/qoriq-arm.inc
require conf/machine/include/arm/arch-arm64.inc

DEFAULTTUNE = "armv7ahf-neon"
SOC_FAMILY = "fsl-lsch2:ls1012a:ls1012a-32b"

UBOOT_CONFIG ??= "qspi"
UBOOT_CONFIG[qspi] = "ls1012ardb_qspi_config,,u-boot-dtb.bin"
UBOOT_CONFIG[qspi-secure-boot] = "ls1012ardb_qspi_SECURE_BOOT_config,,u-boot-dtb.bin"

KERNEL_IMAGETYPE = "zImage"
KERNEL_DEVICETREE ?= "freescale/fsl-ls1012a-rdb.dtb"
KERNEL_DEFCONFIG ?= "${S}/arch/arm/configs/multi_v7_defconfig"

SERIAL_CONSOLES ?= "115200;ttyS0 115200;ttyAMA0"
SERIAL_CONSOLES_CHECK ?= "${SERIAL_CONSOLES}"

EXTRA_IMAGEDEPENDS += "ppa ls1012a-rcw"
USE_VT = "0"

require conf/multilib.conf
MULTILIBS ?= "multilib:lib64"
DEFAULTTUNE_virtclass-multilib-lib64 ?= "aarch64"
```

## conf/machine/ls1012ardb.conf
```bitbake
#@TYPE: Machine
#@NAME: Freescale LS1012ARDB 
#@SOC: LSCH2
#@DESCRIPTION: Machine configuration for running LS1012A in 64-bit mode
#@MAINTAINER: Zongchun Yu <Zongchun.Yu@nxp.com>

require conf/machine/include/qoriq-arm64.inc

SOC_FAMILY = "fsl-lsch2:ls1012a"

UBOOT_CONFIG ??= "qspi-secure-boot qspi"
UBOOT_CONFIG[qspi] = "ls1012ardb_qspi_config,,u-boot-dtb.bin"
UBOOT_CONFIG[qspi-secure-boot] = "ls1012ardb_qspi_SECURE_BOOT_config,,u-boot-dtb.bin"

KERNEL_DEVICETREE ?= "freescale/fsl-ls1012a-rdb.dtb"
KERNEL_DEFCONFIG ?= "${S}/arch/arm64/configs/defconfig"

SERIAL_CONSOLES ?= "115200;ttyS0 115200;ttyAMA0"
SERIAL_CONSOLES_CHECK ?= "${SERIAL_CONSOLES}"

EXTRA_IMAGEDEPENDS += "ppa ls2-rcw"
USE_VT = "0"
```
